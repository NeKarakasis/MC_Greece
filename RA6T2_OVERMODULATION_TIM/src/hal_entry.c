#include "hal_data.h"

FSP_CPP_HEADER
void R_BSP_WarmStart(bsp_warm_start_event_t event);
FSP_CPP_FOOTER

static fsp_err_t gpt_complementary_pwm_mode_3_init(void);

volatile uint8_t counter = 0;

/*******************************************************************************************************************//**
 * main() is generated by the RA Configuration editor and is used to generate threads if an RTOS is used.  This function
 * is called by main() when no RTOS is used.
 **********************************************************************************************************************/
void hal_entry(void)
{
    /* TODO: add your own code here */

    /* Complementary PWM mode Setting */
    gpt_complementary_pwm_mode_3_init ();

    while (1)
    {

    }
}

static fsp_err_t gpt_complementary_pwm_mode_3_init(void)
{
    fsp_err_t err = FSP_SUCCESS;

    /* Initializes the module. */
    err = R_GPT_THREE_PHASE_Open (&g_three_phase0_ctrl, &g_three_phase0_cfg);

    /* Handle any errors. This function should be defined by the user. */
    if (FSP_SUCCESS != err)
    {
        return err;
    }

    R_GPT4->GTCR_b.MD = 0x0E; //0x0C;//0x0D;//0x0E;//14;

    /*
     * GTBER: General PWM Timer Buffer Enable
     * - GTCCR Buffer Operation
     * - GTPR Buffer Operation
     * - GTADTRA/GTADTRB Buffer Operation
     * - GTDVU/GTDVD Buffer
     */
    R_GPT4->GTBER_b.BD0 = 0; //GTCCCR Buffer operation is enabled
    R_GPT4->GTBER_b.BD1 = 0; //GTPR Buffer operation is enabled
    R_GPT4->GTBER_b.BD2 = 1; //GTADTRA/GTADTRB Buffer operation is enabled
    R_GPT4->GTBER_b.BD3 = 0; //GTDUV/GTDVD Buffer operation is enabled
    R_GPT4->GTBER_b.DBRTECA = 0;
    R_GPT4->GTBER_b.DBRTECB = 0;
    R_GPT4->GTBER_b.CCRA = 1; //Single buffer operation (GTCCRA <=> GTCCRC)
    R_GPT4->GTBER_b.CCRB = 1; //Single buffer operation (GTCCRB <=> GTCCRE)
    R_GPT4->GTBER_b.PR = 1; //Single buffer operation (GTPBR <=> GTPR), the setting of this bit does not matter for complementary PWM mode 3, 4
    R_GPT4->GTBER_b.CCRSWT = 0; //No force write
    R_GPT4->GTBER_b.ADTTA = 0;
    R_GPT4->GTBER_b.ADTDA = 0;
    R_GPT4->GTBER_b.ADTTB = 0;
    R_GPT4->GTBER_b.ADTDB = 0;

    R_GPT5->GTBER_b.BD0 = 0; //GTCCCR Buffer operation is enabled
    R_GPT5->GTBER_b.BD1 = 0; //GTPR Buffer operation is enabled
    R_GPT5->GTBER_b.BD2 = 1; //GTADTRA/GTADTRB Buffer operation is enabled
    R_GPT5->GTBER_b.BD3 = 0; //GTDUV/GTDVD Buffer operation is enabled
    R_GPT5->GTBER_b.DBRTECA = 0;
    R_GPT5->GTBER_b.DBRTECB = 0;
    R_GPT5->GTBER_b.CCRA = 1; //Single buffer operation (GTCCRA <=> GTCCRC)
    R_GPT5->GTBER_b.CCRB = 1; //Single buffer operation (GTCCRB <=> GTCCRE)
    R_GPT5->GTBER_b.PR = 1;  //Single buffer operation (GTPBR <=> GTPR)
    R_GPT5->GTBER_b.CCRSWT = 0; //No force write
    R_GPT5->GTBER_b.ADTTA = 0;
    R_GPT5->GTBER_b.ADTDA = 0;
    R_GPT5->GTBER_b.ADTTB = 0;
    R_GPT5->GTBER_b.ADTDB = 0;

    R_GPT6->GTBER_b.BD0 = 0; //GTCCCR Buffer operation is enabled
    R_GPT6->GTBER_b.BD1 = 0; //GTPR Buffer operation is enabled
    R_GPT6->GTBER_b.BD2 = 1; //GTADTRA/GTADTRB Buffer operation is enabled
    R_GPT6->GTBER_b.BD3 = 0; //GTDUV/GTDVD Buffer operation is enabled
    R_GPT6->GTBER_b.DBRTECA = 0;
    R_GPT6->GTBER_b.DBRTECB = 0;
    R_GPT6->GTBER_b.CCRA = 1; //Single buffer operation (GTCCRA <=> GTCCRC)
    R_GPT6->GTBER_b.CCRB = 1; //Single buffer operation (GTCCRB <=> GTCCRE)
    R_GPT6->GTBER_b.PR = 1;  //Single buffer operation (GTPBR <=> GTPR)
    R_GPT6->GTBER_b.CCRSWT = 0; //No force write
    R_GPT6->GTBER_b.ADTTA = 0;
    R_GPT6->GTBER_b.ADTDA = 0;
    R_GPT6->GTBER_b.ADTTB = 0;
    R_GPT6->GTBER_b.ADTDB = 0;

    R_GPT4->GTPR = 0xDAC;
    R_GPT4->GTPBR = 0xDAC;
    R_GPT4->GTPDBR = 0xDAC;

    /*
     * GTIOR : General PWM Timer I/O Control Register
     * - GTIOA/B = 0x09
     *  - Initial output is Low (Active level is High),
     *  - High output in up count compare match
     *  - Low output in down count compare match
     * - GTIOB/B = 0x06
     *  - Initial output is Low (Active level is High),
     *  - Low output in up count compare match
     *  - High output in down count compare match
     * - GTIOA/B = 0x19
     *  - Initial output is High (Active level is Low),
     *  - High output in up count compare match
     *  - Low output in down count compare match
     * - GTIOB/B = 0x16
     *  - Initial output is High (Active level is Low),
     *  - Low output in up count compare match
     *  - High output in down count compare match
     */
    R_GPT4->GTIOR_b.GTIOA = 0x06;
    R_GPT5->GTIOR_b.GTIOA = 0x06;
    R_GPT6->GTIOR_b.GTIOA = 0x06;
    R_GPT4->GTIOR_b.GTIOB = 0x09;
    R_GPT5->GTIOR_b.GTIOB = 0x09;
    R_GPT6->GTIOR_b.GTIOB = 0x09;

    /*PSYE: PWM Synchronous output Enable:
     * Enable GTCPPOT7 output */
    R_GPT4->GTIOR_b.PSYE = 1;

#if 1
    /*
     * GTBER2: General PWM Timer Buffer Enable 2
     * - CP3DB=0 : Disable double buffer function in complementary PWM mode 3, 4
     * - OLTTA: GTIOCnA Output Level Buffer Transfer Timing Select
     * - OLTTB: GTIOCnB Output Level Buffer Transfer Timing Select
     */
    R_GPT4->GTBER2_b.CP3DB = 0;
    R_GPT4->GTBER2_b.OLTTA = 3; //complementary PWM mode: Transfer at both crest and trough
    R_GPT4->GTBER2_b.OLTTB = 3; //complementary PWM mode: Transfer at both crest and trough

    R_GPT5->GTBER2_b.CP3DB = 0;
    R_GPT5->GTBER2_b.OLTTA = 3; //complementary PWM mode: Transfer at both crest and trough
    R_GPT5->GTBER2_b.OLTTB = 3; //complementary PWM mode: Transfer at both crest and trough

    R_GPT6->GTBER2_b.CP3DB = 0;
    R_GPT6->GTBER2_b.OLTTA = 3; //complementary PWM mode: Transfer at both crest and trough
    R_GPT6->GTBER2_b.OLTTB = 3; //complementary PWM mode: Transfer at both crest and trough
#else
    // GTBER2.CP3DB, This bit is only available in GPT324 to GPT329.
    R_GPT4->GTBER2_b.CP3DB = 0;//0x06;//0x0E;//0x05;
    R_GPT5->GTBER2_b.CP3DB = 0;//0x06;//0x0E;//0x05;
    R_GPT6->GTBER2_b.CP3DB = 0;//0x06;//0x0E;//0x05;
#endif

    R_GPT4->GTCCR[4] = 0x5DC;
    R_GPT5->GTCCR[4] = 0x5DC;
    R_GPT6->GTCCR[4] = 0x5DC;

    /* Start the timer. */
    err = R_GPT_THREE_PHASE_Start (&g_three_phase0_ctrl);

    if (FSP_SUCCESS != err)
    {
        return err;
    }

    return FSP_SUCCESS;
}

//uint8_t isExecuted = false; // Flag to track if the block has been executed
void gpt_c_t(timer_callback_args_t *p_args)
{

    /* TODO: add your own code here */
    if (p_args->event == TIMER_EVENT_CREST)
    {
        counter++;

        if (counter == 3)

        {
            R_GPT4->GTCCR[4] = R_GPT4->GTPR / 4;
            R_GPT5->GTCCR[4] = R_GPT4->GTPR / 4;
            R_GPT6->GTCCR[4] = R_GPT4->GTPR / 4;
        }

        else if (counter == 6)

        {
            R_GPT4->GTCCR[4] = 0; // R_GPT4->GTPR + R_GPT4->GTDVU;
            R_GPT5->GTCCR[4] = 0; // R_GPT4->GTPR + R_GPT4->GTDVU;
            R_GPT6->GTCCR[4] = 0; // R_GPT4->GTPR + R_GPT4->GTDVU;
            counter = 0;

        }

    }
    if (p_args->event == TIMER_EVENT_TROUGH)
    {

        //     R_GPT4->GTCCR[4] = R_GPT4->GTPR -1;
        //   R_GPT5->GTCCR[4] = R_GPT4->GTPR -1;
        //   R_GPT6->GTCCR[4] = R_GPT4->GTPR -1;

    }
}

/*******************************************************************************************************************//**
 * This function is called at various points during the startup process.  This implementation uses the event that is
 * called right before main() to set up the pins.
 *
 * @param[in]  event    Where at in the start up process the code is currently at
 **********************************************************************************************************************/
void R_BSP_WarmStart(bsp_warm_start_event_t event)
{
    if (BSP_WARM_START_RESET == event)
    {
#if BSP_FEATURE_FLASH_LP_VERSION != 0

        /* Enable reading from data flash. */
        R_FACI_LP->DFLCTL = 1U;

        /* Would normally have to wait tDSTOP(6us) for data flash recovery. Placing the enable here, before clock and
         * C runtime initialization, should negate the need for a delay since the initialization will typically take more than 6us. */
#endif
    }

    if (BSP_WARM_START_POST_C == event)
    {
        /* C runtime environment and system clocks are setup. */

        /* Configure pins. */
        R_IOPORT_Open (&g_ioport_ctrl, g_ioport.p_cfg);
    }
}

#if BSP_TZ_SECURE_BUILD

BSP_CMSE_NONSECURE_ENTRY void template_nonsecure_callable ();

/* Trustzone Secure Projects require at least one nonsecure callable function in order to build (Remove this if it is not required to build). */
BSP_CMSE_NONSECURE_ENTRY void template_nonsecure_callable ()
{

}
#endif
